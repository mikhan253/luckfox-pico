## br2-external/Config.in
```kconfig
source "$BR2_EXTERNAL_MIK_PATH/package/python-fastcrc/Config.in"
source "$BR2_EXTERNAL_MIK_PATH/package/python-bjoern/Config.in"
source "$BR2_EXTERNAL_MIK_PATH/package/eiwd/Config.in"
```

## br2-external/package/eiwd/Config.in
```kconfig
config BR2_PACKAGE_EIWD
    bool "eiwd (iwd ohne D-Bus)"
    select BR2_PACKAGE_ELL
    help
      Fork von iwd, der ohne D-Bus auskommt. https://github.com/illiliti/eiwd
```

## br2-external/package/python-bjoern/Config.in
```kconfig
config BR2_PACKAGE_PYTHON_BJOERN
	bool "python-bjoern"
	depends on BR2_PACKAGE_PYTHON3
	select BR2_PACKAGE_LIBEV
	select BR2_PACKAGE_HOST_PKGCONF
	help
	  A screamingly fast Python 2+3 WSGI server written in C.

	  https://github.com/jonashaag/bjoern
```
